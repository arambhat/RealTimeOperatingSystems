## CMakeLists.txt
```
cmake_minimum_required(VERSION 3.20.0)

set(BOARD mimxrt1050_evk)
set(BOARD_FLASH_RUNNER jlink)
find_package(Zephyr REQUIRED HINTS $ENV{ZEPHYR_BASE})
project(ashishapp)
target_sources(app PRIVATE src/main.c src/task_model_p4.h)
target_compile_options(app PRIVATE -Wall)
```

## prj.conf
```kconfig
CONFIG_CPLUSPLUS=y
CONFIG_PRINTK=y
CONFIG_SHELL=y
CONFIG_LOG=y
CONFIG_LOG_BACKEND_UART=y
CONFIG_STDOUT_CONSOLE=y
# enable to use thread names
CONFIG_THREAD_NAME=y
CONFIG_SEGGER_SYSTEMVIEW=y
CONFIG_USE_SEGGER_RTT=y
CONFIG_PRIORITY_CEILING=0
#CONFIG_TRACING=y
```

## src/main.c
```c
#include <zephyr.h>
#include <kernel.h>
#include <sys/printk.h>
#include <sys/util.h>
#include <stdbool.h>
#include <stdlib.h>
#include "task_model_p4.h"
#include <timing/timing.h>
#include <shell/shell_uart.h>

//#define DEBUG
K_CONDVAR_DEFINE(activate_signal);
K_MUTEX_DEFINE(activate_mutex);

#define DEBUG

#if defined(DEBUG) 
	#define DPRINTK(fmt, args...) printk("DEBUG: %s():%d: " fmt, \
   		 __func__, __LINE__, ##args)
#else
 	#define DPRINTK(fmt, args...) // do nothing if not defined
#endif

#define STACK_SIZE  4096

#define compiler_barrier() do { \
	__asm__ __volatile__ ("" ::: "memory"); \
} while (false)


// Global flag threads use to determine if to stop running
static bool running = true;

// k_thread structures / data
static struct k_thread thread_structs[NUM_THREADS];
static k_tid_t thread_tids[NUM_THREADS];

static int thread_index[NUM_THREADS];

static int done[NUM_THREADS];
static struct k_sem wait_sem[NUM_THREADS];

// Support up to sixteen threads' stacks
static K_THREAD_STACK_DEFINE(thread_stack_area, STACK_SIZE * NUM_THREADS);

static void timer_expiry_function(struct k_timer *timer_exp)
{
    int id = *(int *)timer_exp->user_data;
    int ret;

    ret = done[id];  
    if (ret==1) {
        k_sem_give(&wait_sem[id]);
    }
    else {
        printk("task %d misses its deadline \n", id);
        k_sem_give(&wait_sem[id]);
    }
}

// Function that is executed for each thread in the task set
static void thread(void *v_task_info, void *v_thread_id, void *unused)
{
    //wait for activation input from shell command
    k_mutex_lock(&activate_mutex, K_FOREVER);
    //k_condvar_wait(&activate_signal, &activate_mutex, K_FOREVER);
    k_mutex_unlock(&activate_mutex);

    struct task_s *task_info = (struct task_s *)v_task_info;
    int thread_id = *(int *)v_thread_id; 
 
	uint32_t period, next=0, begin = 0;

    struct k_timer task_timer;

    k_timer_init(&task_timer, timer_expiry_function, NULL);
    task_timer.user_data = v_thread_id;

    printk("task %d gets started \n", thread_id);

	period = 1000000*task_info->period; 
	begin = k_cycle_get_32();

    k_timer_start(&task_timer,K_NSEC(period), K_NSEC(period));

    while (running) {

        // Run compute
        DPRINTK("Thread %d running task\n", thread_id);

        done[thread_id]=0;

		next = next + period;
        looping(task_info->loop_iter);
        compiler_barrier();

        // Sleep for period
        DPRINTK("Thread %d sleeping for %d ms\n", thread_id, task_info->period);

        done[thread_id]=1;
        k_sem_take(&wait_sem[thread_id], K_FOREVER);
    }
}

// Start all threads defined in the task set
static void start_threads(void)
{

    for (int i = 0; i < NUM_THREADS; i++) {
        k_sem_init(&wait_sem[i], 0, 1);
        done[i]=0;
    }

    // Small delay to make sure we set each thread's name before it runs

    // Start each thread
    for (int i = 0; i < NUM_THREADS; i++) {
		thread_index[i]=i;
        thread_tids[i] = k_thread_create(&thread_structs[i],
                                         &thread_stack_area[STACK_SIZE * i],
                                         STACK_SIZE * sizeof(k_thread_stack_t),
                                         thread, (void *)&threads[i],
                                         (void *)&thread_index[i], NULL, threads[i].priority,
                                         0, K_MSEC(10));

        k_thread_name_set(thread_tids[i], threads[i].t_name);

    }
    printk("Threads Initialized!\n");
}

// "Entry point" of our code
void main(void)
{


    // Spawn the threads
    start_threads();


    // wait for signal to start timeout

    k_mutex_lock(&activate_mutex, K_FOREVER);
    //k_condvar_wait(&activate_signal, &activate_mutex, K_FOREVER);
    k_mutex_unlock(&activate_mutex);

    k_sleep(K_MSEC(TOTAL_TIME));
    // Stop the threads!
    running = false;

    //terminate waiting threads waiting on semaphore
    for (int i = 0; i < NUM_THREADS; ++i) {
        k_sem_give(&wait_sem[i]);
    }

    //wait for threads to exit
    for (int i = 0; i < NUM_THREADS; ++i) {
        k_thread_join(&thread_structs[i],K_FOREVER);
    }

    printk("Stopped threads\n");

}

static int activate_function(const struct shell *shell,
                            size_t argc, char **argv)
{
    ARG_UNUSED(argc);
    ARG_UNUSED(argv);

    k_mutex_lock(&activate_mutex, K_FOREVER);
    //Broadcast condition valid
    k_condvar_broadcast(&activate_signal);
    k_mutex_unlock(&activate_mutex);

    return 0;
}

SHELL_CMD_ARG_REGISTER(activate, NULL, "Activate to start program", activate_function,1,0);
```

## src/task_model_p4.h
```c
#ifndef __TASK_MODEL_H__
#define __TASK_MODEL_H__

/*
 * 
 */
//#define DEBUG 

#if defined(DEBUG) 
	#define DPRINTK(fmt, args...) printk("DEBUG: %s():%d: " fmt, \
   		 __func__, __LINE__, ##args)
#else
 	#define DPRINTK(fmt, args...) // do nothing if not defined
#endif

#define compiler_barrier() do { \
	__asm__ __volatile__ ("" ::: "memory"); \
} while (false)

#define STACK_SIZE  4096

#define NUM_THREADS	4		// number of threads
#define TOTAL_TIME 30000  	// total execution time in milliseconds
#define MAX_RECORD 150

struct task_s           // struct for periodic task
{
	char t_name[32]; 	// task name
	int priority; 		// priority of the task
	int period; 		// period for periodic task in milliseconds
	int loop_iter; 	   // loop iterations for compute
};

#define THREAD0 {"task00", 5, 50, 1680000}
#define THREAD1 {"task11", 8, 160, 3500000}
#define THREAD2 {"task22", 9, 220, 3640000}
#define THREAD3 {"task33", 10, 360, 3640000}

struct task_s threads[NUM_THREADS]={THREAD0, THREAD1, THREAD2, THREAD3};

struct task_aps         // struct for polling server
{
	char t_name[32]; 	// task name
	int priority; 		// assigned priority of the task
	int period; 		// replenishment period for polling task in milliseconds
	int budget; 		// budget of polling task in milliseconds
	k_tid_t poll_tid;   // thread id for the polling server
	uint32_t last_switched_in;     
	int left_budget;		// remaining budget in nanoseconds
};

#define POLL_PRIO   6
#define BUDGET 30       // execution budget for polling server in milliseconds

struct task_aps poll_info = {"polling_t", POLL_PRIO, 120, BUDGET, NULL, 0, 1000000*BUDGET};

struct req_type {       // struct for aperiodic requests
    uint32_t id;
    uint32_t iterations;    // loop iterations for compute
    uint32_t arr_time;      // the arrival time of the request
};

static void req_expiry_function(struct k_timer *timer_exp);

K_MSGQ_DEFINE(req_msgq, sizeof(struct req_type), 20, 4);
K_TIMER_DEFINE(req_timer, req_expiry_function, NULL);

// variance to generate random numbers
#define VAR_R    0
#define VAR_A    0.4
#define VAR_L    0.5

// Loop to emulate task execution
void looping(int loop_count) 
{
    volatile int t1 = loop_count;

    while (t1 > 0) t1--;
    compiler_barrier();
}

// generate random number between base*(1-var) and base
static uint32_t rand_dist(int base, float var)  
{
    int iter;
    int range;

    range = base*var;
    iter = base; 
    if (range > 0) {
        iter = iter * (1-var) + rand() % range;
    }
    return iter;

}

// end-start, if end < start, add overflow
uint64_t sub32(uint32_t start, uint32_t end)  
{  
    uint64_t a, b;

    a = (uint64_t) start;
    b = (uint64_t) end;

    if (b>a) 
            return (b-a);
    else {
        return ((b + 1<32) -a);
    }
}

#define ARR_TIME 15000      // interarrival time of aperiodic requests in microseconds
#define REQ_LOOP 420000     // aperiodic request loop count
int total_req=0;

// Timer allback function to generate aperiodic requests
static void req_expiry_function(struct k_timer *timer_exp)
{
    uint32_t stime;
    struct req_type data;

    data.id = total_req;
    data.iterations = rand_dist(REQ_LOOP, VAR_R);
    data.arr_time = k_cycle_get_32();
    k_msgq_put(&req_msgq, &data, K_NO_WAIT);
    
    total_req++;

    stime = rand_dist(ARR_TIME, VAR_A);
    k_timer_start(&req_timer, K_USEC(stime), K_NO_WAIT);

}

#endif // __TASK_MODEL_H__
```
